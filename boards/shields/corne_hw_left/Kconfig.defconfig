## boards/shields/corne_hw_left/Kconfig.defconfig
```kconfig
if SHIELD_CORNE_HW_LEFT

config ZMK_KEYBOARD_NAME
    default "Baikal"

config ZMK_SPLIT_ROLE_CENTRAL
    default y

endif
```

## boards/shields/corne_hw_right/Kconfig.defconfig
```kconfig
if SHIELD_CORNE_HW_RIGHT

config ZMK_KEYBOARD_NAME
    default "Baikal"

config ZMK_SPLIT_ROLE_CENTRAL
    default n

endif
```
